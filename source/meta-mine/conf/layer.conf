## source/meta-mine/conf/layer.conf
```bitbake
BBPATH =. "${LAYERDIR}:"

BBFILES += "${LAYERDIR}/recipes-*/*/*.bb\
		${LAYERDIR}/recipes-*/*/*.bbappend"

BBFILE_COLLECTIONS += "mine"
BBFILE_PATTERN_mine := "^${LAYERDIR}"
BBFILE_PRIORITY_mine = "91"

#HOSTTOOLS_append = "javac jar javah"

LAYERDIPENDS_mine = "core"

LAYER_COMPAT_mine = "thud"
```

## source/meta-sec/conf/layer.conf
```bitbake
BBPATH =. "${LAYERDIR}:"

BBFILES += "${LAYERDIR}/recipes-*/*/*.bb\
		${LAYERDIR}/recipes-*/*/*.bbappend"

BBFILE_COLLECTIONS += "sec"
BBFILE_PATTERN_sec := "^${LAYERDIR}"
BBFILE_PRIORITY_sec = "91"

#HOSTTOOLS_append = "javac jar javah"

LAYERDIPENDS_sec = "core"

LAYER_COMPAT_sec = "kirkstone"
```
